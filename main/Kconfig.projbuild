## main/Kconfig.projbuild
```kconfig
menu "PBL3 HiveMQ Configuration"

    config PBL3_WIFI_SSID
        string "Wi-Fi SSID"
        default "Life"
        help
            Wi-Fi network name used by the ESP32 gateway.

    config PBL3_WIFI_PASSWORD
        string "Wi-Fi password"
        default "giangdaika"
        help
            Wi-Fi password used by the ESP32 gateway.

    config PBL3_MQTT_BROKER_URI
        string "HiveMQ broker URI"
        default "mqtts://e300ad6fcfbd42eb9ae0e8614baf1e11.s1.eu.hivemq.cloud:8883"
        help
            HiveMQ Cloud MQTT over TLS endpoint. Use mqtts://host:8883.

    config PBL3_MQTT_USERNAME
        string "HiveMQ username"
        default "longhihihaha123"
        help
            Username created in HiveMQ Cloud Access Management.

    config PBL3_MQTT_PASSWORD
        string "HiveMQ password"
        default "Long@12345"
        help
            Password created in HiveMQ Cloud Access Management.

endmenu
```
